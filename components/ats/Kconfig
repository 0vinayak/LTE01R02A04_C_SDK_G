## components/ats/Kconfig
```kconfig
# Copyright (C) 2018 RDA Technologies Limited and/or its affiliates("RDA").
# All rights reserved.
#
# This software is supplied "AS IS" without any warranties.
# RDA assumes no responsibility or liability for the use of the software,
# conveys no license or title under any patent, copyright, or mask work
# right to the product. RDA reserves the right to make changes in the
# software without notification.  RDA also make no representation or
# warranty that such application will be suitable for the specified use
# without further testing or modification.

menu "AT commands"

orsource "audio/Kconfig"
orsource "http/Kconfig"
orsource "coap/Kconfig"
orsource "ftp/Kconfig"
orsource "tcpip/Kconfig"
orsource "cfw/Kconfig"
orsource "lwm2m/Kconfig"
orsource "ssim/Kconfig"
orsource "dm/Kconfig"
orsource "cam/Kconfig"
orsource "misc/Kconfig"
orsource "mqtt/Kconfig"
orsource "apn/Kconfig"
orsource "cc/Kconfig"
orsource "gc/Kconfig"
orsource "sms/Kconfig"
orsource "ss/Kconfig"
orsource "pbk/Kconfig"
orsource "gprs/Kconfig"
orsource "nw/Kconfig"
orsource "alic/Kconfig"
orsource "bt/Kconfig"
orsource "wifi/Kconfig"
orsource "sat/Kconfig"
orsource "sim/Kconfig"
orsource "iperf/Kconfig"
orsource "cus/Kconfig"
orsource "loc/Kconfig"
orsource "ids/Kconfig"
orsource "ctsm/Kconfig"
orsource "unikey/Kconfig"
orsource "uni_mqtt/Kconfig"
orsource "efuse/Kconfig"
orsource "sntp/Kconfig"

endmenu
```

## components/ats/audio/Kconfig
```kconfig
# Copyright (C) 2018 RDA Technologies Limited and/or its affiliates("RDA").
# All rights reserved.
#
# This software is supplied "AS IS" without any warranties.
# RDA assumes no responsibility or liability for the use of the software,
# conveys no license or title under any patent, copyright, or mask work
# right to the product. RDA reserves the right to make changes in the
# software without notification.  RDA also make no representation or
# warranty that such application will be suitable for the specified use
# without further testing or modification.

menu "AT audio commands"

config AT_AUDIO_SUPPORT
    bool "AT_AUDIO_SUPPORT enabled"
    default y if SOC_8910
    default y if QUEC_PROJECT_FEATURE_VOICE_CALL #quectel volte版本涉及音频参数调节
    default n
    help
        Enable audio AT commands

config AT_AUDIO_COMMAND_SUPPORT
    bool "AT_AUDIO_COMMAND_SUPPORT enabled"
    default y
    select AUDIO_COMMAND_SUPPORT
    help
        When enabled, some at command can be used, ie CDTMF

endmenu
```

## components/ats/cam/Kconfig
```kconfig
# Copyright (C) 2018 RDA Technologies Limited and/or its affiliates("RDA").
# All rights reserved.
#
# This software is supplied "AS IS" without any warranties.
# RDA assumes no responsibility or liability for the use of the software,
# conveys no license or title under any patent, copyright, or mask work
# right to the product. RDA reserves the right to make changes in the
# software without notification.  RDA also make no representation or
# warranty that such application will be suitable for the specified use
# without further testing or modification.

menu "at_camera"

if CAMERA_SUPPORT
config AT_CAMERA_SUPPORT
    bool "Support AT CAM command"
    default n
    help
        When defined, AT CAM command will be used.

if AT_CAMERA_SUPPORT

config AT_CAMERA_PREV_WRITEFILE
    bool "Support AT camera prev write file"
    default y
    help
        When defined, will not lcd show.

config AT_CAMERA_PREV_DISPLAY_LCD
    bool "Support AT CAM lcd display"
    default y
    help
        When defined, AT CAM will be lcd display.

config AT_CAMERA_TEST_MODE
    bool "Support AT CAM Test mode"
    default y
    help
        When defined, AT CAM will use test mode.

endif
endif

if SOC_8850

config AT_BACKLIGHT
    bool "Support AT BACKLIGHT"
    default y
    help
        When defined, AT command will open backlight.

endif

endmenu
```

## components/ats/cc/Kconfig
```kconfig
# Copyright (C) 2018 RDA Technologies Limited and/or its affiliates("RDA").
# All rights reserved.
#
# This software is supplied "AS IS" without any warranties.
# RDA assumes no responsibility or liability for the use of the software,
# conveys no license or title under any patent, copyright, or mask work
# right to the product. RDA reserves the right to make changes in the
# software without notification.  RDA also make no representation or
# warranty that such application will be suitable for the specified use
# without further testing or modification.

menu "at_cc"

config AT_CC_COMMAND_SUPPORT
    bool "AT_CC_COMMAND_SUPPORT enabled"
    #quectel adjust
    #default n if SOC_8850
	#default n if SOC_8811
    #default y
	default y if QUEC_PROJECT_FEATURE_VOICE_CALL
	default n
	select CC_COMMAND_SUPPORT
    help
        When enabled, some at command can be used, ie ATA

config AT_CC_COMMAND_DAILUP_SUPPORT
    bool "AT_CC_COMMAND_DAILUP_SUPPORTSUPPORT enabled"
	default y
    select CC_COMMAND_DAILUP_SUPPORT
    help
        When enabled, D and CDU command can be used, ie ATA

config DTMF_KEY_DETECT_SUPPORT
    bool "DTMF_KEY_DETECT_SUPPORT enabled"
    default n
    select AUDIO_CALL_KEYTONE_DETECT_SUPPORT
    help
        When enabled, CONFIG_DTMF_KEY_DETECT_SUPPORT will be defined
		

endmenu
```

## components/ats/dm/Kconfig
```kconfig
# Copyright (C) 2018 RDA Technologies Limited and/or its affiliates("RDA").
# All rights reserved.
#
# This software is supplied "AS IS" without any warranties.
# RDA assumes no responsibility or liability for the use of the software,
# conveys no license or title under any patent, copyright, or mask work
# right to the product. RDA reserves the right to make changes in the
# software without notification.  RDA also make no representation or
# warranty that such application will be suitable for the specified use
# without further testing or modification.

menu "at_dm"

choice
	prompt "DM feature"
	default AT_DM_CUS_SUPPORT if AT_CUS_SUPPORT
	default AT_DM_SUPPORT
config AT_DM_SUPPORT
	bool "AT_DM_SUPPORT enabled"
	depends on NET_DM_CISSDK_SUPPORT || NET_DM_LWM2M_SUPPORT
config AT_DM_CUS_SUPPORT
	bool "AT_DM_CUS_SUPPORT enabled"
	depends on NET_DM_CUS_SUPPORT
config AT_NO_DM_SUPPORT
	bool "AT DM not support"
endchoice

endmenu
```

## components/ats/gprs/Kconfig
```kconfig
# Copyright (C) 2018 RDA Technologies Limited and/or its affiliates("RDA").
# All rights reserved.
#
# This software is supplied "AS IS" without any warranties.
# RDA assumes no responsibility or liability for the use of the software,
# conveys no license or title under any patent, copyright, or mask work
# right to the product. RDA reserves the right to make changes in the
# software without notification.  RDA also make no representation or
# warranty that such application will be suitable for the specified use
# without further testing or modification.

menu "at_gprs"

config AT_GPRS_COMMAND_SUPPORT
    bool "AT_GPRS_COMMAND_SUPPORT enabled"
    default y
    select GPRS_COMMAND_SUPPORT
    help
        When enabled, some at command can be used, ie CFGDFTPDN

config AT_MAL_SUPPORT
    bool "AT_MAL_SUPPORT enabled"
    default n if (SOC_8811) || (SOC_8821)
    default y
    select MAL_SUPPORT
    help
        When enabled, AT_MAL_SUPPORT will be defined

config AT_GPRS_DEFAULT_LTE_CID
    int "default LTE CID"
    default 5
    help
        Default LTE cid for AT command. default value is 5, range 1-7.

endmenu
```

## components/ats/lwm2m/Kconfig
```kconfig
# Copyright (C) 2018 RDA Technologies Limited and/or its affiliates("RDA").
# All rights reserved.
#
# This software is supplied "AS IS" without any warranties.
# RDA assumes no responsibility or liability for the use of the software,
# conveys no license or title under any patent, copyright, or mask work
# right to the product. RDA reserves the right to make changes in the
# software without notification.  RDA also make no representation or
# warranty that such application will be suitable for the specified use
# without further testing or modification.

menu "at_lwm2m"

choice
	prompt "AT_MIPL_SUPPORT"
	default AT_CUS_MIPL_SUPPORT if AT_CUS_SUPPORT
	default AT_LWM2M_MIPL_SUPPORT if SOC_8811 || SOC_8850 || SOC_8821
	default AT_CISSDK_MIPL_SUPPORT
config AT_CISSDK_MIPL_SUPPORT
	bool "AT_CISSDK_MIPL_SUPPORT enabled"
	select NET_CIS_SDK_SUPPORT
config AT_LWM2M_MIPL_SUPPORT
	bool "AT_LWM2M_MIPL_SUPPORT enabled"
	select NET_LWM2M_SUPPORT
	select LWM2M_ONENET_SUPPORT
config AT_LWM2M_MIPL_SOTA_SUPPORT
	bool "AT_LWM2M_MIPL_SOTA_SUPPORT enabled"
	depends on AT_LWM2M_MIPL_SUPPORT
	default y if SOC_8811 || SOC_8821
	select LWM2M_ONENET_UPDATE
	select LWM2M_ONENET_SOTA
config AT_CUS_MIPL_SUPPORT
	bool "AT_CUS_MIPL_SUPPORT enabled"
	select NET_LWM2M_SUPPORT
	select LWM2M_ONENET_SUPPORT
config AT_NO_MIPL_SUPPORT
	bool "AT_NO_MIPL_SUPPORT enabled"

endchoice

config AT_OCEANCONNECT_SUPPORT
    bool "AT_OCEANCONNECT_SUPPORT enabled"
    default y
    select NET_LWM2M_SUPPORT
    help
        When enabled, AT_OCEANCONNECT_SUPPORT will be defined

config AT_CTWING_SUPPORT
    bool "AT_CTWING_SUPPORT enabled"
    default n if SOC_8910
    default y
    select NET_LWM2M_SUPPORT
	select LWM2M_CTWING_SUPPORT
    help
        When enabled, AT_AEP_SUPPORT will be defined

config AT_CTWING_SELFREG_SUPPORT
    bool "AT_CTWING_SELFREG_SUPPORT enabled"
    depends on AT_CTWING_SUPPORT
    default y if SOC_8811 || SOC_8821
    select NET_CTWING_SELFREG_SUPPORT
    help
        When enabled, AT_CTWING_SELFREG_SUPPORT will be defined
		
config AT_CTWING_NEW_STANDARD
    bool "AT_CTWING_NEW_STANDARD enabled"
    default n
	depends on AT_CTWING_SUPPORT
	select LWM2M_CTWING_NEW_STANDARD
    help
        When enabled, AT_CTWING_NEW_STANDARD will be defined

endmenu
```

## components/ats/misc/Kconfig
```kconfig
# Copyright (C) 2018 RDA Technologies Limited and/or its affiliates("RDA").
# All rights reserved.
#
# This software is supplied "AS IS" without any warranties.
# RDA assumes no responsibility or liability for the use of the software,
# conveys no license or title under any patent, copyright, or mask work
# right to the product. RDA reserves the right to make changes in the
# software without notification.  RDA also make no representation or
# warranty that such application will be suitable for the specified use
# without further testing or modification.

menu "at_cmd_unisoc"

config AT_UNISOC_SPECIAL_SUPPORT
    bool "UNISOC special AT command support"
    default y if SOC_8910 || SOC_8811 || SOC_8850 || SOC_8821
    default n

if AT_UNISOC_SPECIAL_SUPPORT

config AT_EMMCDDRSIZE_SUPPORT
    bool "Enable +EMMCDDRSIZE"
    default y
    help
        AT command to read flash and RAM(PSRAM or DDR) capacity

config AT_U_CREATE_AT_CHANNEL
    bool "Create AT channel (UNISOC)"
    default y

endif

config AT_UTEST_SUPPORT
    bool "Support Utest for I2C, GPIO and PM"
    default n
    help
        When defined, UTEST AT Command can be used.

config AT_ARMLOG_SUPPORT
    bool "Support ArmLogel AT command or not"
    default y if KERNEL_DIAG_TRACE
    default n

config AT_SELFREG_SUPPORT
	bool "AT_SELFREG_SUPPORT enabled"
	depends on NET_SELFREG_COAP_SUPPORT
	default y
	help
		When enabled, AT_DM_SUPPORT will be defined

endmenu
```

## components/ats/sms/Kconfig
```kconfig
# Copyright (C) 2018 RDA Technologies Limited and/or its affiliates("RDA").
# All rights reserved.
#
# This software is supplied "AS IS" without any warranties.
# RDA assumes no responsibility or liability for the use of the software,
# conveys no license or title under any patent, copyright, or mask work
# right to the product. RDA reserves the right to make changes in the
# software without notification.  RDA also make no representation or
# warranty that such application will be suitable for the specified use
# without further testing or modification.

menu "at_sms"

config AT_SMS_COMMAND_SUPPORT
    bool "AT_SMS_COMMAND_SUPPORT enabled"
    default y
    select SMS_COMMAND_SUPPORT
    help
        When enabled, some at command can be used, ie CSCB

config CONCAT_SMS_SUPPORT
    bool "CONCAT_SMS_SUPPORT enabled"
    default y if SOC_8850
    default n
    help
        When enabled, CONFIG_CONCAT_SMS_SUPPORT will be defined

config LIMITED_NUMBER_SMS_SUPPORT
    bool "LIMITED_NUMBER_SMS_SUPPORT enabled"
    default n
    help
        When enabled, CONFIG_LIMITED_NUMBER_SMS_SUPPORT will be defined

config AT_SMS_CB_SUPPORT
    bool "SMS_CB_SUPPORT enabled"
    default y if SOC_8910 || SOC_8850
    default n
    help
        When enabled, Cell Broadcast Service will be supported

config AT_UNSOLICITED_RESULT_CODES_MAX
    int "Max sms unsolicited result codes count"
    default 20
    help
        Maximum count for sms of unsolicited result codes urc store.

endmenu
```

## components/ats/tcpip/Kconfig
```kconfig
# Copyright (C) 2018 RDA Technologies Limited and/or its affiliates("RDA").
# All rights reserved.
#
# This software is supplied "AS IS" without any warranties.
# RDA assumes no responsibility or liability for the use of the software,
# conveys no license or title under any patent, copyright, or mask work
# right to the product. RDA reserves the right to make changes in the
# software without notification.  RDA also make no representation or
# warranty that such application will be suitable for the specified use
# without further testing or modification.

menu "at_tcpip"

config AT_TCPIP_SUPPORT
    bool "AT_TCPIP_SUPPORT enabled"
    default y
    depends on NET_LWIP_TCP_ON
    help
        When enabled, AT_TCPIP_SUPPORT will be defined

config AT_UDP_SUPPORT
    bool "AT_UDP_SUPPORT enabled"
    default n if (SOC_8811) || (SOC_8821)
    default n if SOC_8910
    default n
    depends on NET_LWIP_TCP_ON
    help
        When enabled, AT_UDP_SUPPORT will be defined

config AT_MYNET_TCPIP_SUPPORT
    bool "AT_MYNET_TCPIP_SUPPORT enabled"
	default y if SOC_8910
    default n
    depends on NET_LWIP_TCP_ON
    help
        When enabled, AT_MYNET_TCPIP_SUPPORT will be defined

config AT_MBEDTLS_TCPIP_SUPPORT
    bool "AT_MBEDTLS_TCPIP_SUPPORT enabled"
    default y if SOC_8910
    default y if SOC_8850
    default n
    depends on MBEDTLS_TCPIP_SUPPORT
    help
        When enabled, AT_MBEDTLS_TCPIP_SUPPORT will be defined

config AT_USSL_SUPPORT
    bool "AT_USSL_SUPPORT enabled"
    default n if SOC_8910
    default n
    depends on NET_USSL_SUPPORT
    help
        When enabled, AT_USSL_SUPPORT will be defined

config AT_TCPIP_FULL_FUNC_SUPPORT
    bool "AT_TCPIP_FULL_FUNC_SUPPORT enabled"
    default y
    depends on NET_LWIP_TCP_ON
    help
        When enabled, AT_TCPIP_FULL_FUNC_SUPPORT will be defined

 config AT_TCPCTWING_SUPPORT
    bool "AT_TCPCTWING_SUPPORT enabled"
    default n if SOC_8910
    default n if SOC_8850
    default n
    depends on NET_LWIP_TCP_ON
    help
        When enabled, AT_TCPCTWING_SUPPORT will be defined
endmenu
```

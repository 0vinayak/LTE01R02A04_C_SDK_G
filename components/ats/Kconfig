## components/firmwareupdate/Kconfig
```kconfig
# Copyright (C) 2018 RDA Technologies Limited and/or its affiliates("RDA").
# All rights reserved.
#
# This software is supplied "AS IS" without any warranties.
# RDA assumes no responsibility or liability for the use of the software,
# conveys no license or title under any patent, copyright, or mask work
# right to the product. RDA reserves the right to make changes in the
# software without notification.  RDA also make no representation or
# warranty that such application will be suitable for the specified use
# without further testing or modification.

menu "firmware update"

config FUPDATE_PACK_FILE_NAME
    string "update pack file name"
    default "fota.pack"
    help
        This is the file name of firmware upgrade pack file name. It is
        located under CONFIG_FS_FOTA_DATA_DIR. The configuration should
        be the same in application and bootloader.

        Don't change it unless you know what you are doing.

config FUPDATE_STAGE_FILE_NAME
    string "update stage file name"
    default "fota.stage"
    help
        This file will record firmware updata stage. It is located under
        CONFIG_FS_FOTA_DATA_DIR. The configuration should be the same in
        application and bootloader.

        Don't change it unless you know what you are doing.

config FUPDATE_TEMP_FILE_NAME
    string "update temporal file name"
    default "fota.tmp"
    help
        This is temporal file create during update in bootloader.

        Don't change it unless you know what you are doing.

config FUPDATE_SUPPORT_FLASH_PATCH
    bool "support flash differential update"
    default y
    help
        Support differential update of flash regions.

config FUPDATE_SUPPORT_FS_PATCH
    bool "support file system differential update"
    default y if SOC_8910
    default n
    help
        Support differential update of file system. Only SFFS is supported.

config FUPDATE_SUPPORT_BLOCKED_FILE
    bool "support blocked file"
    default y if SOC_8910
    default y if SOC_8850
    default n

config FUPDATE_SUPPORT_SIGNATURE_CHECK
    bool "support fota signature check"
    default n if SOC_8850   #quectel updtae
    default y if SOC_8910
    default n

config FUPDATE_SIGN_FILE_NAME
    string "update signature file name"
    default "fota.sign"
    help
        This is signature file name of the firmware update pack file.
        It contains the signature of the update pack file. 

        Don't change it unless you know what you are doing.

config FUPDATE_SUPPORT_VERSION_CHECK
    bool "support fota package old/new version check"
    default y if SOC_8910
    default n
    help
        If this option is enabled, it will check the versions of
        new & old firmwares before upgrading the fota package. Forbid new
        version being updated to old version by default.

config FUPDATE_CHECK_SECURE_VERSION
    bool "fota check secure version"
    default n if SOC_8850
    default n
    help
        If secure boot is enabled, fota will check the secure version of the new pac.
        If the version < secure version in Efuse, fota upgrade process will be stoped.   
config FUPDATE_SUPPORT_CHECK_TMP_SPACE
    bool "support fota check tmp space"
    default y if SOC_8910
    default n if SOC_8850  #quectel updtae
    default n
    help
        If this option is enabled, it will check unused flash size, if
        flash size is not enough for fota, the update process will quit. 
endmenu
```

## components/fs/Kconfig
```kconfig
# Copyright (C) 2018 RDA Technologies Limited and/or its affiliates("RDA").
# All rights reserved.
#
# This software is supplied "AS IS" without any warranties.
# RDA assumes no responsibility or liability for the use of the software,
# conveys no license or title under any patent, copyright, or mask work
# right to the product. RDA reserves the right to make changes in the
# software without notification.  RDA also make no representation or
# warranty that such application will be suitable for the specified use
# without further testing or modification.

menu "file system"

choice
    prompt "flash block device version"
    default FS_FBDEV_DEFAULT_V2
    help
        There are 2 versions of flash block device implementation. These
        2 versions are incompatible.

    config FS_FBDEV_DEFAULT_V1
        bool "version 1"

    config FS_FBDEV_DEFAULT_V2
        bool "version 2"
endchoice

config FS_FBDEV_V1_SUPPORTED
    bool "Support flash block device v1"
    default n
    help
        When enabled, flash block device v1 will be supported. Except for
        backward compatible consideration, don't enable it.

config FS_FBDEV_V2_SUPPORTED
    bool "Support flash block device v2"
    default y
    help
        When enabled, flash block device v2 will be supported.

config FS_FORMAT_FLASH_ON_MOUNT_FAIL
    bool "format at mount fail"
    default n
    help
        When file system mount failed, system can't go on. When this is
        enabled, system will format the flash region, and try mount again.
        Then system can go on, but all existed data will be lost.

        Don't enable this in production.

config FS_MOUNT_SDCARD
    bool "Mount sdcard"
    depends on SDIO_SUPPORT
    default n
    help
        When EMMC and SDMMC Driver support,can be mounted.

if FS_MOUNT_SDCARD

config FS_FORMAT_SDCARD_ON_MOUNT_FAIL
    bool "Format sdcard on mount fail"
    default y

config FS_SDCARD_MOUNT_POINT
    string "Sdcard mount point"
    #default "/sdcard/part0"
    default "/sdcard0"

choice
    prompt "Select File System on the SDCard"
    default FS_SUPPORT_FAT_ON_SDCARD

    config FS_SUPPORT_LFS_ON_SDCARD
        bool "Support LittleFS on EMMC or SDCard"
        help
            When this is enabled, user can mount LittleFS on a EMMC or SDCard,
            then reads and writes the file system by vfs APIs.

    config FS_SUPPORT_FAT_ON_SDCARD
        bool "Support Fat on EMMC or SDCard"
        help
            When this is enabled, user can mount Fat file system on a EMMC or SDCard,
            then reads and writes the file system by vfs APIs.
endchoice

endif

config FS_SDCARD_PART_NUM
    int "The Number of Partitions divided on SDCard"
    #default 1
    default 4 #adjust by quectel

config FS_SUPPORT_NAND_SFS
    bool "SUPPORT NAND SFS"
    default n
    help
        When NAND Driver support,can be used.

config FS_SUPPORT_LFS_ON_NAND
    bool "Support LittleFS on NAND flash"
    default n
    help
        When this is enabled, user can mount a LittleFS on a raw nand flash,
        then reads and writes the file system by vfs APIs.

endmenu
```

## components/gnss/Kconfig
```kconfig
# Copyright (C) 2018 RDA Technologies Limited and/or its affiliates("RDA").
# All rights reserved.
#
# This software is supplied "AS IS" without any warranties.
# RDA assumes no responsibility or liability for the use of the software,
# conveys no license or title under any patent, copyright, or mask work
# right to the product. RDA reserves the right to make changes in the
# software without notification.  RDA also make no representation or
# warranty that such application will be suitable for the specified use
# without further testing or modification.

menu "GNSS"

config SUPPORT_GNSS
    bool "Support GNSS"
    default y
    help
    	When defined, Target device can support GNSS position fix

choice
	prompt "GNSS chip version"
	depends on SUPPORT_GNSS
	default GPS_CHIP_VER_GREENEYE2

config GPS_CHIP_VER_GREENEYE2
	depends on SUPPORT_GNSS
	bool "GE2"

config GPS_CHIP_VER_NONE
	depends on SUPPORT_GNSS
	bool "None"

endchoice

choice
	prompt "Switch of GNSS FW Mode"
	default GPS_MODE_GPS_BD

config GPS_MODE_GPS_BD
	bool "GPS BDS"

config GPS_MODE_GPS_GLONASS
	bool "GPS GLONASS"

endchoice

config GPS_TCARD_LOG_SUPPORT
    bool "Switch of GNSS tcard log storage"
    default n

config GPS_MINI_LOG_SUPPORT
    bool "Switch of GNSS MINI mini log"
    default y

choice
	prompt "Switch of A-GNSS"
	default GPS_AGPS_SUPPORT_QX

config GPS_AGPS_SUPPORT_NONE
	bool "NONE"

config GPS_AGPS_SUPPORT_QX
	bool "QXWZ"

config GPS_AGPS_SUPPORT_SPRD_AGPS
	bool "SPRD AGNSS"

endchoice

choice
	prompt "GNSS COMM MODE"
	default GPS_TRANS_VIA_SIPC

config GPS_TRANS_VIA_UART
	bool "UART"

config GPS_TRANS_VIA_SIPC
	bool "SIPC"

endchoice

config GPS_SPREAD_ORBIT_SUPPORT
    bool "Support SPREAD ORBIT"
    default n

choice
	prompt "Spread Orbit Mode"
	depends on GPS_SPREAD_ORBIT_SUPPORT
	default SPREAD_ORBIT_MODE_GPS

config SPREAD_ORBIT_MODE_GPS
	depends on GPS_SPREAD_ORBIT_SUPPORT
	bool "GPS"

config BDS
	depends on GPS_SPREAD_ORBIT_SUPPORT
	bool "GPS_BDS"

endchoice

choice
	prompt "Spread Orbit PreDayNum"
	depends on GPS_SPREAD_ORBIT_SUPPORT
	default SPREAD_ORBIT_PRED_DAYS1

config SPREAD_ORBIT_PRED_DAYS1
	depends on GPS_SPREAD_ORBIT_SUPPORT
	bool "pread days 1"

config SPREAD_ORBIT_PRED_DAYS2
	depends on GPS_SPREAD_ORBIT_SUPPORT
	bool "pread days 2"

endchoice

endmenu
```
